/* ===== LOADING SCREEN BITMAP ===== */
const unsigned char boot_logo [] PROGMEM = {
	0x00, 0x00, 0x00, 0x00, 0x00, 0x00, 0x00, 0x00, 0x00, 0x00, 0x00, 0x00, 0x00, 0x00, 0x00, 0x00, 
	0x00, 0x00, 0x00, 0x00, 0x00, 0x00, 0x00, 0x00, 0x00, 0x00, 0x00, 0x00, 0x00, 0x00, 0x00, 0x00, 
	0x00, 0x00, 0x00, 0x00, 0x00, 0x00, 0x00, 0x00, 0x00, 0x00, 0x00, 0x00, 0x00, 0x00, 0x00, 0x00, 
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	0x00, 0x00, 0x00, 0x00, 0x00, 0x00, 0x00, 0x00, 0x00, 0x00, 0x00, 0x00, 0x00, 0x00, 0x00, 0x00
};

/* ===== LIBRARIES ===== */
#include <SPI.h>
#include <Adafruit_GFX.h>
#include <Adafruit_ILI9341.h>
#include <WiFi.h>
#include <esp_wifi.h>

/* ===== WIFI MONITOR DATA ===== */
volatile uint32_t wm_packets = 0;
volatile int wm_rssiSum = 0;
volatile int wm_rssiCount = 0;
uint16_t wm_ppsHistory[40];
uint8_t wm_graphIndex = 0;
uint16_t wm_maxPPS = 400;
unsigned long wm_lastSecond = 0;
uint32_t wm_lastPackets = 0;
volatile bool exitWifiMonitor = false;


/* ===== TFT DISPLAY PINS ===== */
#define TFT_SCK   18
#define TFT_MOSI  23
#define TFT_CS    5
#define TFT_DC    2
#define TFT_RST   4
Adafruit_ILI9341 tft = Adafruit_ILI9341(TFT_CS, TFT_DC, TFT_RST);

/* ===== BUZZER ===== */
#define buzzer 15

/* ===== BUTTONS ===== */
#define button_left 27
#define button_right 26
#define button_up 32
#define button_down 33
#define button_select 25

/* ===== BITMAP SIZE  ===== */
#define LOGO_W 320
#define LOGO_H 240

#define menuItems 3
int itemHeight = 30;
int selectedItem = 0;

struct MenuItem {
  const char* text;
  uint16_t color;
};

/* ===== MENU ===== */
MenuItem menu[menuItems] = {
  { "))) Wi-Fi Monitor",   ILI9341_GREEN   },
  { "# Vulnerability",   ILI9341_RED    },
  { "? Network Info",    ILI9341_YELLOW  }
};

/* ===== WIFI MONITOR ===== */
/* ===== Sniffer ===== */
void IRAM_ATTR wifiSniffer(void* buf, wifi_promiscuous_pkt_type_t type) {
  const wifi_promiscuous_pkt_t* pkt = (wifi_promiscuous_pkt_t*)buf;
  wm_packets++;
  wm_rssiSum += pkt->rx_ctrl.rssi;
  wm_rssiCount++;
}

/* ===== Wi-Fi Monitor GRAPH===== */
void drawWmGraph() {
  int gx = 10, gy = 160, gw = 220, gh = 60;
  tft.fillRect(gx, gy, gw, gh, ILI9341_BLACK);
  tft.drawRect(gx, gy, gw, gh, ILI9341_DARKGREY);

  for (int i = 1; i < 40; i++) {
    int i1 = (wm_graphIndex + i - 1) % 40;
    int i2 = (wm_graphIndex + i) % 40;
    int x1 = gx + (i - 1) * gw / 40;
    int y1 = gy + gh - map(wm_ppsHistory[i1], 0, wm_maxPPS, 0, gh);
    int x2 = gx + i * gw / 40;
    int y2 = gy + gh - map(wm_ppsHistory[i2], 0, wm_maxPPS, 0, gh);

    tft.drawLine(x1, y1, x2, y2, ILI9341_GREEN);
  }
}

/* ===== MELODY START */
void bootBeep() {
  tone(buzzer, 440, 150); delay(200);
  tone(buzzer, 660, 150); delay(200);
  tone(buzzer, 880, 200); delay(300);
  noTone(buzzer);
}

/* =====DRAW BITMAP ===== */
void drawMonoBitmap(const uint8_t *bitmap, int w, int h, int x, int y, uint16_t color) {
  int byteWidth = (w + 7) / 8;
  for (int j = 0; j < h; j++) {
    for (int i = 0; i < w; i++) {
      if (pgm_read_byte(bitmap + j * byteWidth + i / 8) & (128 >> (i & 7))) {
        tft.drawPixel(x + i, y + j, color);
      }
    }
  }
}

/* ===== DRAW MENU ===== */
void drawMenu() {
  tft.fillScreen(ILI9341_BLACK);

  // ===== HEADER =====
  tft.setTextSize(3);
  tft.setTextColor(ILI9341_WHITE);

  int16_t x1, y1;
  uint16_t w, h;
  tft.getTextBounds("WScanner", 0, 0, &x1, &y1, &w, &h);
  tft.setCursor((tft.width() - w) / 2, 10);
  tft.print("WScanner");

  tft.drawFastHLine(20, 45, tft.width() - 40, ILI9341_DARKGREY);

  // ===== MENU SIZE =====
  int startY = 60;
  int cardHeight = 40;
  int cardMargin = 10;

  tft.setTextSize(2);

  for (int i = 0; i < menuItems; i++) {
    int y = startY + i * (cardHeight + cardMargin);

    // BACKGROUND
    if (i == selectedItem) {
      tft.fillRoundRect(
        10, y,
        tft.width() - 20, cardHeight,
        8,
        ILI9341_BLUE
      );
      tft.drawRoundRect(
        10, y,
        tft.width() - 20, cardHeight,
        8,
        ILI9341_WHITE
      );
      tft.setTextColor(ILI9341_WHITE);
    } else {
      tft.drawRoundRect(
        10, y,
        tft.width() - 20, cardHeight,
        8,
        ILI9341_DARKGREY
      );
      tft.setTextColor(menu[i].color);
    }

    // LEFT MARKER
    tft.fillCircle(22, y + cardHeight / 2, 4,
                   (i == selectedItem) ? ILI9341_WHITE : menu[i].color);

    // TEXT OF MENU
    tft.setCursor(35, y + 12);
    tft.print(menu[i].text);
  }
}


/* ===== Wi-Fi Monitor ===== */
enum StatusLevel {
  STATUS_OK,
  STATUS_HIGH,
  STATUS_SUSPICIOUS
};


void wifiMonitor() {
  exitWifiMonitor = false;
	tft.fillScreen(ILI9341_BLACK);
  tft.setTextSize(3);
  tft.setTextColor(ILI9341_GREEN, ILI9341_BLACK);
  tft.setCursor(10, 5);
  tft.print("Wi-Fi Monitor");

  wm_packets = 0;
  wm_rssiSum = 0;
  wm_rssiCount = 0;
  wm_lastPackets = 0;

  for (int i = 0; i < 40; i++) {
    wm_ppsHistory[i] = 0;
  }

  volatile uint32_t beaconPackets = 0;
  volatile uint32_t dataPackets   = 0;
  volatile uint32_t probePackets  = 0;

  WiFi.mode(WIFI_MODE_STA);
  esp_wifi_set_promiscuous(false);
  esp_wifi_set_promiscuous_rx_cb(wifiSniffer);
  esp_wifi_start();
  esp_wifi_set_promiscuous(true);

  wm_lastSecond = millis();
  wm_lastPackets = 0;
  wm_graphIndex = 0;

  // Initialize UI State
  StatusLevel currentStatus = STATUS_OK;
  uint16_t currentStatusColor = ILI9341_GREEN;
  
  // Initial Background Draw of Status Bar
  tft.fillRect(0, 40, tft.width(), 30, currentStatusColor);
  
  // Initial Labels inside Status Bar
  tft.setTextColor(ILI9341_BLACK, currentStatusColor);
  tft.setTextSize(2);
  tft.setCursor(10, 48);
  tft.print("STATUS: OK");

  // Initial Labels for Data (Black Background)
  tft.setTextColor(ILI9341_WHITE, ILI9341_BLACK);
  tft.setCursor(10, 80);
  tft.print("PPS: 0");
  tft.setCursor(130, 80);
  tft.print("RSSI: 0 dBm");
  tft.setCursor(10, 105);
  tft.print("Packets: 0");

  unsigned long lastFastUpdate = 0;

  while (true) {
    // Check button - Exit to Menu
    if (digitalRead(button_left) == LOW) {
  exitWifiMonitor = true;
}
	if (exitWifiMonitor) {
		esp_wifi_set_promiscuous(false);
		esp_wifi_stop();
		WiFi.mode(WIFI_OFF);

		delay(200);
		drawMenu();
		return;
}


    unsigned long currentMillis = millis();

    // ===== FAST UI UPDATE (Every 50ms) =====
    if (currentMillis - lastFastUpdate >= 50) {
      lastFastUpdate = currentMillis;

      // Estimate live RSSI
      int liveRSSI = (wm_rssiCount > 0) ? wm_rssiSum / wm_rssiCount : -100;

      tft.setTextSize(2);
      tft.setTextColor(ILI9341_WHITE, ILI9341_BLACK); // Black background for data
      
      // Update RSSI (Fast) at Y=80 (Right side)
      tft.setCursor(130, 80);
      tft.printf("RSSI: %d dBm  ", liveRSSI);

      // Update Packets Total (Fast) at Y=105
      tft.setCursor(10, 105);
      tft.printf("Packets: %d   ", wm_packets);
    }

    // ===== SLOW LOGIC UPDATE (Every 1000ms) =====
    if (currentMillis - wm_lastSecond >= 1000) {
      wm_lastSecond = currentMillis;
      
      uint32_t currentPPS = wm_packets - wm_lastPackets;
      wm_lastPackets = wm_packets;

      int avgRSSI = (wm_rssiCount > 0) ? wm_rssiSum / wm_rssiCount : -100;
      
      // Reset logic counters
      wm_rssiSum = 0;
      wm_rssiCount = 0;

      wm_ppsHistory[wm_graphIndex] = currentPPS;
      wm_graphIndex = (wm_graphIndex + 1) % 40;

      // Status Logic
      uint32_t avgPPS = 0;
      for (int i = 0; i < 40; i++) avgPPS += wm_ppsHistory[i];
      avgPPS /= 40;

      StatusLevel newStatus = STATUS_OK;
      if (avgPPS > 50 && currentPPS > avgPPS * 3) newStatus = STATUS_SUSPICIOUS;
      else if (currentPPS > 300) newStatus = STATUS_HIGH;

      // Determine colors
      uint16_t newStatusColor = ILI9341_GREEN;
      const char* statusText = "OK";
      if (newStatus == STATUS_HIGH) { newStatusColor = ILI9341_YELLOW; statusText = "HIGH TRAFFIC"; }
      else if (newStatus == STATUS_SUSPICIOUS) { newStatusColor = ILI9341_RED; statusText = "SUSPICIOUS"; }

      // Redraw Status Bar Background ONLY if changed
      if (newStatus != currentStatus) {
        tft.fillRect(0, 40, tft.width(), 30, newStatusColor);
        tft.setTextColor(ILI9341_BLACK, newStatusColor);
        tft.setTextSize(2);
        tft.setCursor(10, 48);
        tft.print("STATUS: ");
        tft.print(statusText);
        
        currentStatus = newStatus;
        currentStatusColor = newStatusColor;
        
        // Alert sound
        if (newStatus == STATUS_SUSPICIOUS) {
           tone(buzzer, 1200, 80);
        }
      }

      // Update PPS (1Hz) at Y=80 (Left side)
      tft.setTextSize(2);
      tft.setTextColor(ILI9341_WHITE, ILI9341_BLACK); // Black background
      tft.setCursor(10, 80);
      tft.printf("PPS: %d   ", currentPPS);

      
      // Update RSSI Bar at Y=200
      int rssiBar = map(avgRSSI, -100, -30, 0, 100);
      rssiBar = constrain(rssiBar, 0, 100);
      tft.fillRect(10 + rssiBar * 2, 200, 200 - rssiBar * 2, 8, ILI9341_BLACK); // Clear tail
      tft.fillRect(10, 200, rssiBar * 2, 8, ILI9341_CYAN); // Draw bar
      tft.drawRect(10, 200, 200, 8, ILI9341_DARKGREY); // Draw frame

      drawWmGraph();
    }
  }
}


void drawBar(int x, int y, int w, int h, int val, int maxVal, uint16_t color) {
    tft.drawRect(x, y, w, h, ILI9341_DARKGREY);
    int barW = map(val, 0, maxVal, 0, w-2);
    barW = constrain(barW, 0, w-2);
    tft.fillRect(x+1, y+1, barW, h-2, color);
}

/* ===== VULNERABILITIES ===== */
void vulnerabilities() {
  // 1. Show immediate feedback
  tft.fillScreen(ILI9341_BLACK);
  tft.setTextSize(2);
  tft.setTextColor(ILI9341_ORANGE);
  tft.setCursor(50, 10);
  tft.print("VULNERABILITIES");
  tft.drawFastHLine(0, 35, 320, ILI9341_DARKGREY);
  
  tft.setTextSize(3);
  tft.setCursor(10, 50);
  tft.setTextColor(ILI9341_YELLOW);
  tft.print("Scanning...");

  // 2. Perform scan (blocking)
  WiFi.mode(WIFI_STA);
  WiFi.disconnect();
  int n = WiFi.scanNetworks();

  if (n <= 0) {
    tft.fillRect(0, 40, 320, 200, ILI9341_BLACK);
    tft.setTextColor(ILI9341_RED);
    tft.setTextSize(2);
    tft.setCursor(10, 50);
    tft.print("No networks found");
    delay(2000);
    drawMenu();
    return;
  }

  int selected = 0;
  int scroll = 0;
  const int perPage = 5;
  bool redraw = true;

  while (true) {
    if (digitalRead(button_down) == LOW) {
      selected++;
      if (selected >= n) selected = 0;
      if (selected >= scroll + perPage) scroll = selected - perPage + 1;
      if (selected < scroll) scroll = selected;
      redraw = true;
      delay(150);
    }

    if (digitalRead(button_up) == LOW) {
      selected--;
      if (selected < 0) selected = n - 1;
      if (selected < scroll) scroll = selected;
      if (selected >= scroll + perPage) scroll = selected - perPage + 1;
      redraw = true;
      delay(150);
    }

    if (digitalRead(button_left) == LOW) {
      delay(200);
      break;
    }

    // ==== DRAW ====
    if (redraw) {
      tft.fillRect(0, 36, 320, 204, ILI9341_BLACK);
      int y = 45;

      for (int i = 0; i < perPage; i++) {
        int idx = scroll + i;
        if (idx >= n) break;

        String ssid = WiFi.SSID(idx);
        if (ssid.length() > 18) ssid = ssid.substring(0, 15) + "...";

        String issues = "";
        int risk = 0;

        wifi_auth_mode_t enc = WiFi.encryptionType(idx);
        if (enc == WIFI_AUTH_OPEN) { issues += "Open, "; risk += 2; }
        else if (enc == WIFI_AUTH_WEP) { issues += "WEP, "; risk += 2; }
        else if (enc == WIFI_AUTH_WPA_PSK) { issues += "WPA, "; risk += 1; }

        int dup = 0;
        for (int j = 0; j < n; j++) {
          if (WiFi.SSID(j) == WiFi.SSID(idx)) dup++;
        }
        if (dup > 1) { issues += "Duplicate SSID, "; risk += 1; }

        if (issues.length() == 0) issues = "No issues";
        else issues.remove(issues.length() - 2);

        String riskText = "SECURE";
        uint16_t color = ILI9341_GREEN;
        if (risk == 1) { riskText = "MEDIUM"; color = ILI9341_YELLOW; }
        else if (risk == 2) { riskText = "HIGH"; color = ILI9341_ORANGE; }
        else if (risk >= 3) { riskText = "CRITICAL"; color = ILI9341_RED; }

        if (idx == selected) {
          tft.fillRoundRect(5, y, 310, 34, 5, ILI9341_BLUE);
          tft.drawRoundRect(5, y, 310, 34, 5, ILI9341_WHITE);
        } else {
          tft.drawRoundRect(5, y, 310, 34, 5, ILI9341_DARKGREY);
        }

        tft.setTextSize(2);
        tft.setTextColor(ILI9341_WHITE);
        tft.setCursor(10, y + 2);
        tft.print(ssid);

        tft.setTextSize(1);
        tft.setTextColor(color);
        tft.setCursor(10, y + 20);
        tft.print(riskText);
        tft.print(" - ");
        tft.print(issues);

        y += 38;
      }
      redraw = false;
    }
    delay(10);
  }

  drawMenu();
}



String formatUptime() {
  unsigned long ms = millis();
  unsigned long sec = ms / 1000;
  unsigned long min = sec / 60;
  unsigned long hr = min / 60;
  
  char buffer[16];
  sprintf(buffer, "%02lu:%02lu:%02lu", hr, min % 60, sec % 60);
  return String(buffer);
}

void drawRSSIBarMini(int x, int y, int rssi) {
  int width = 30;
  int height = 10;
  
  // Frame
  tft.drawRect(x, y, width, height, ILI9341_DARKGREY);
  
  // Fill
  int percent = map(rssi, -90, -30, 0, 100);
  percent = constrain(percent, 0, 100);
  int barW = (width - 2) * percent / 100;
  
  uint16_t color = ILI9341_GREEN;
  if(rssi < -70) color = ILI9341_YELLOW;
  if(rssi < -80) color = ILI9341_RED;
  
  tft.fillRect(x + 1, y + 1, barW, height - 2, color);
  tft.fillRect(x + 1 + barW, y + 1, (width - 2) - barW, height - 2, ILI9341_BLACK);
}

int countDuplicateSSID(String ssid) {
  int count = 0;
  int n = WiFi.scanComplete();
  if(n < 0) return 0;
  for(int i=0; i<n; i++) {
    if(WiFi.SSID(i) == ssid) count++;
  }
  return count;
}

void showNetworkDetails(int idx) {
    tft.fillScreen(ILI9341_BLACK);

    String ssid = WiFi.SSID(idx);
    String bssid = WiFi.BSSIDstr(idx);
    int32_t rssi = WiFi.RSSI(idx);
    wifi_auth_mode_t enc = WiFi.encryptionType(idx);
    int32_t channel = WiFi.channel(idx);

//    String vendor = getVendor(bssid);
    int apCount = countDuplicateSSID(ssid);

    // Risk Calc
    int riskScore = 0; // 0=Safe, 1=Low, 2=Med, 3=High
    if(enc == WIFI_AUTH_OPEN) riskScore += 1;
    if(apCount > 1) riskScore += 1;
    if(enc == WIFI_AUTH_WEP) riskScore += 2;

    String riskStr = "Low";
    uint16_t riskColor = ILI9341_GREEN;
    if(riskScore == 1) { riskStr = "Medium"; riskColor = ILI9341_YELLOW; }
    else if(riskScore == 2) { riskStr = "High"; riskColor = ILI9341_ORANGE; }
    else if(riskScore >= 3) { riskStr = "CRITICAL"; riskColor = ILI9341_RED; }

    // Header: SSID
    tft.setTextColor(ILI9341_CYAN);
    tft.setTextSize(2);
    tft.setCursor(10, 5);
    tft.println(ssid);

    tft.drawFastHLine(0, 28, 320, ILI9341_DARKGREY);

    int y = 35;
    int lineHeight = 26;

    // BSSID
    tft.setTextColor(ILI9341_LIGHTGREY);
    tft.setTextSize(2);
    tft.setCursor(10, y);
    tft.print("BSSID: ");
    tft.setTextColor(ILI9341_WHITE);
    tft.print(bssid);
    y += lineHeight;

    // Vendor AFTER BSSID
    //tft.setTextColor(ILI9341_LIGHTGREY);
    //tft.setCursor(10, y);
    //tft.print("Vendor: ");
    //tft.setTextColor(ILI9341_WHITE);
    //tft.print(vendor);
    //y += lineHeight;

    // Encryption
    tft.setTextColor(ILI9341_LIGHTGREY);
    tft.setCursor(10, y);
    tft.print("Enc: ");
    tft.setTextColor(ILI9341_WHITE);
    String encStr = "OPEN";
    switch(enc) {
        case WIFI_AUTH_OPEN: encStr = "OPEN"; break;
        case WIFI_AUTH_WEP: encStr = "WEP"; break;
        case WIFI_AUTH_WPA_PSK: encStr = "WPA"; break;
        case WIFI_AUTH_WPA2_PSK: encStr = "WPA2"; break;
        case WIFI_AUTH_WPA_WPA2_PSK: encStr = "WPA*"; break;
        case WIFI_AUTH_WPA3_PSK: encStr = "WPA3"; break;
        default: encStr = "UNKNOWN"; break;
    }
    tft.print(encStr);
    y += lineHeight;

    // Channel
    tft.setTextColor(ILI9341_LIGHTGREY);
    tft.setCursor(10, y);
    tft.print("Ch: ");
    tft.setTextColor(ILI9341_WHITE);
    tft.print(channel);
    tft.print(" (2.4G)");
    y += lineHeight;

    // Signal
    tft.setTextColor(ILI9341_LIGHTGREY);
    tft.setCursor(10, y);
    tft.print("Signal: ");
    tft.setTextColor(ILI9341_WHITE);
    int quality = constrain(map(rssi, -100, -35, 0, 100), 0, 100);
    tft.print(rssi); tft.print("dBm "); tft.print(quality); tft.print("%");
    y += lineHeight + 5;

    // Clone APs
    tft.setTextColor(ILI9341_LIGHTGREY);
    tft.setCursor(10, y);
    tft.print("Clone APs: ");
    tft.setTextColor(apCount > 1 ? ILI9341_YELLOW : ILI9341_GREEN);
    tft.print(apCount);
    y += lineHeight;

    // Risk
    tft.setTextColor(ILI9341_LIGHTGREY);
    tft.setCursor(10, y);
    tft.print("Risk: ");
    tft.setTextColor(riskColor);
    tft.print(riskStr);
    y += lineHeight;

    // Wait for button press to exit
    while(digitalRead(button_select) == LOW || digitalRead(button_left) == LOW) { delay(10); }
    delay(100);
    while(true) {
        if(digitalRead(button_left) == LOW || digitalRead(button_select) == LOW) {
            delay(200);
            break;
        }
    }
}


void networkInfo() {
  tft.fillScreen(ILI9341_BLACK);
  
  // Header
  tft.setTextColor(ILI9341_CYAN);
  tft.setTextSize(2);
  tft.setCursor(10, 5);
  tft.print("Network Info");
  
  tft.setTextColor(ILI9341_WHITE);
  tft.setTextSize(1);
  tft.setCursor(200, 10);
  tft.print("UP: ");
  tft.print(formatUptime());

  tft.drawFastHLine(0, 25, 320, ILI9341_DARKGREY);
  tft.setTextSize(3);
  tft.setCursor(10, 35);
  tft.setTextColor(ILI9341_YELLOW);
  tft.print("Scanning...");

  WiFi.mode(WIFI_STA);
  WiFi.disconnect();
  int n = WiFi.scanNetworks();
  
  tft.fillRect(0, 30, 320, 210, ILI9341_BLACK); // Clear "Scanning..."

  if (n == 0) {
    tft.setCursor(10, 40);
    tft.setTextColor(ILI9341_RED);
    tft.print("No networks found");
    delay(2000);
  } else {
    // Navigation state
    int selectedIndex = 0;
    int scrollIndex = 0;
    
    // Adjusted layout for rounded cards
    const int linesPerPage = 6; 
    int cardHeight = 28;
    int cardMargin = 4;
    int listStartY = 35;
    
    bool refresh = true;
    unsigned long lastUpdate = 0;

    while (true) {
      if (digitalRead(button_left) == LOW) { delay(200); break; }
      
      if (digitalRead(button_down) == LOW) {
        selectedIndex++;
        if (selectedIndex >= n) selectedIndex = 0;
        
        // Auto-scroll
        if(selectedIndex >= scrollIndex + linesPerPage) scrollIndex = selectedIndex - linesPerPage + 1;
        if(selectedIndex < scrollIndex) scrollIndex = selectedIndex;
        
        refresh = true;
        delay(150); 
      }
      
      if (digitalRead(button_up) == LOW) {
        selectedIndex--;
        if (selectedIndex < 0) selectedIndex = n - 1;
        
        // Auto-scroll
        if(selectedIndex < scrollIndex) scrollIndex = selectedIndex;
        if(selectedIndex >= scrollIndex + linesPerPage) scrollIndex = selectedIndex - linesPerPage + 1;
        
        refresh = true;
        delay(150);
      }
      
      if (digitalRead(button_select) == LOW) {
          showNetworkDetails(selectedIndex);
          // Redraw full UI after returning
          tft.fillScreen(ILI9341_BLACK);
          tft.setTextColor(ILI9341_CYAN); tft.setTextSize(2);
          tft.setCursor(10, 5); tft.print("Network Info");
          tft.drawFastHLine(0, 25, 320, ILI9341_DARKGREY);
          refresh = true;
          while(digitalRead(button_select) == LOW); // Wait release
      }

      if (millis() - lastUpdate > 1000) {
        lastUpdate = millis();
        tft.fillRect(220, 0, 100, 20, ILI9341_BLACK);
        tft.setTextColor(ILI9341_WHITE);
        tft.setTextSize(1);
        tft.setCursor(220, 10);
        tft.print(formatUptime());
      }
      
      if (refresh) {
        // Clear list area
        tft.fillRect(0, 30, 320, 210, ILI9341_BLACK);
        
        for (int i = 0; i < linesPerPage; i++) {
          int idx = scrollIndex + i;
          if (idx >= n) break;
          
          int y = listStartY + i * (cardHeight + cardMargin);
          
          // Draw Card Background
          if (idx == selectedIndex) {
              tft.fillRoundRect(5, y, 310, cardHeight, 6, ILI9341_BLUE);
              tft.drawRoundRect(5, y, 310, cardHeight, 6, ILI9341_WHITE);
          } else {
              tft.drawRoundRect(5, y, 310, cardHeight, 6, ILI9341_DARKGREY);
          }
          
          // 1. SSID
          tft.setTextColor(ILI9341_WHITE);
          tft.setTextSize(1);
          int textY = y + 10;
          
          tft.setCursor(10, textY);
          String ssid = WiFi.SSID(idx);
          if(ssid.length() > 18) ssid = ssid.substring(0, 15) + "...";
          tft.print(idx + 1); 
          tft.print(". ");
          tft.print(ssid);
          
          // 2. Encryption
          tft.setCursor(170, textY);
          wifi_auth_mode_t enc = WiFi.encryptionType(idx);
          if(enc == WIFI_AUTH_OPEN) {
             tft.setTextColor(ILI9341_GREEN);
             tft.print("OPEN");
          } else {
             tft.setTextColor(ILI9341_RED);
             switch (enc) {
               case WIFI_AUTH_WEP: tft.print("WEP"); break;
               case WIFI_AUTH_WPA_PSK: tft.print("WPA"); break;
               case WIFI_AUTH_WPA2_PSK: tft.print("WPA2"); break;
               case WIFI_AUTH_WPA_WPA2_PSK: tft.print("WPA*"); break;
               case WIFI_AUTH_WPA3_PSK: tft.print("WPA3"); break;
               default: tft.print("LOCK"); break;
             }
          }
          
          // 3. RSSI Value Text
          tft.setTextColor(ILI9341_LIGHTGREY);
          tft.setCursor(215, textY);
          tft.print(WiFi.RSSI(idx));
          
          // 4. RSSI Bar
          drawRSSIBarMini(255, y + 9, WiFi.RSSI(idx));
        }
        refresh = false;
      }
    }
  }
  drawMenu();
}


void setup() {
  Serial.begin(115200);
  
  pinMode(buzzer, OUTPUT);
  pinMode(button_left, INPUT_PULLUP);
  pinMode(button_right, INPUT_PULLUP);
  pinMode(button_up, INPUT_PULLUP);
  pinMode(button_down, INPUT_PULLUP);
  pinMode(button_select, INPUT_PULLUP);

  tft.begin();
  tft.setRotation(1);
  tft.fillScreen(ILI9341_BLACK);

  drawMonoBitmap(boot_logo, LOGO_W, LOGO_H, (tft.width()-LOGO_W)/2, (tft.height()-LOGO_H)/2, ILI9341_WHITE);

  bootBeep();
  delay(1000);

  drawMenu();
}

bool lastUp = HIGH, lastDown = HIGH, lastSelect = HIGH, lastLeft = HIGH;
unsigned long lastBtnTime = 0;
const unsigned long debounceDelay = 150;

void loop() {
  bool up = digitalRead(button_up);
  bool down = digitalRead(button_down);
  bool left = digitalRead(button_left);
  bool select = digitalRead(button_select);

  if (millis() - lastBtnTime < debounceDelay) return;

  if (lastUp == HIGH && up == LOW) { selectedItem--; if (selectedItem<0) selectedItem=menuItems-1; drawMenu(); lastBtnTime=millis();}
  if (lastDown == HIGH && down == LOW) { selectedItem++; if (selectedItem>=menuItems) selectedItem=0; drawMenu(); lastBtnTime=millis();}
  if (lastSelect == HIGH && select == LOW) { lastBtnTime=millis();
    switch(selectedItem){
      case 0: wifiMonitor(); break;
      case 1: vulnerabilities(); break;
      case 2: networkInfo(); break;
    }
  }

  lastUp=up; lastDown=down; lastSelect=select; lastLeft=left;
}
